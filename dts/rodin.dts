/dts-v1/;

/include/ "mt6989.dtsi"

/*
 * UniXNU 板级描述：Redmi Turbo 4（rodin / MT6899，天玑 8400-Ultra）。
 *
 * 这是 schema 2 ADT 生成器（scripts/unixnu/devicetree.py generate()）消费的
 * 板级契约：内存必须且只能是一个连续 DRAM 段，且与 board.toml
 * [payload] dram_size 完全一致；/cpus、/psci、GIC 来自 mt6989.dtsi
 * （unixnu-mt6989-common，真机 DTB 反编译）。
 *
 * 已填值来自真机实测（2026-11-14）：
 *   atag,videolfb 0xFCC20000 / 0x33D0000，hwcode 0x6899，
 *   DRAM 0x40000000 + 0x300000000（12 GiB，单段），
 *   UFS HCI 0x112b0000/0x2a00、PHY 0x112a0000，GIC 0x0c400000/0x0c440000。
 */
/ {
    compatible = "xiaomi,rodin", "mediatek,mt6899";
    model = "Xiaomi Redmi Turbo 4";

    memory@40000000 {
        device_type = "memory";
        /* 12 GiB 单段：0x40000000..0x33FFFFFFF（真机 /proc/iomem） */
        reg = <0x0 0x40000000 0x3 0x00000000>;
    };

    cpus {
        cpu-count = <8>;   /* 4+3+1 三簇，PSCI enable-method（mt6989.dtsi） */
    };

    soc {
        compatible = "mediatek,mt6899";
        /* 记录板级地址；ADT 导出以 dtsi 中带 unixnu,adt-name 的节点为准 */
        ufs = <0x0 0x112b0000 0x0 0x00002a00>;
        ufs-phy = <0x0 0x112a0000 0x0 0x00010000>;
        gic = <0x0 0x0c400000>;
        display = <1220 2712 32>;
    };
};
